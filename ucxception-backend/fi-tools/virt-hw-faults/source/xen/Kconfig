## ucxception-backend/fi-tools/virt-hw-faults/source/xen/Kconfig
```kconfig
#
# For a description of the syntax of this configuration file,
# see docs/misc/kconfig-language.txt
#
mainmenu "Xen/$SRCARCH $XEN_FULLVERSION Configuration"

menu "Fault Injection"

config FAULT_INJECTION
	bool "Enable fault injector"
	default y

config FAULT_INJECTION_VERBOSE
	depends on FAULT_INJECTION
	bool "Produce output messages for logging"
	default y

endmenu

menu "Live inter-vmm migration"
config MIGRATION_PERFMON
	bool "Monitors performance and statistics regarding a migration"
	default y

config MIGRATION_CHECKSUM_PAGES
	bool "Performs a checksum of every migrated page. Useful for debugging"
	default n
endmenu

config SRCARCH
	string
	option env="SRCARCH"

config ARCH
	string
	option env="ARCH"

config BROKEN
	bool

source "arch/$SRCARCH/Kconfig"

config XEN_FULLVERSION
	string
	option env="XEN_FULLVERSION"

config DEFCONFIG_LIST
	string
	option defconfig_list
	default "$ARCH_DEFCONFIG"

config EXPERT
	string
	option env="XEN_CONFIG_EXPERT"

config LTO
	bool "Link Time Optimisation"
	depends on BROKEN
	---help---
	  Enable Link Time Optimisation.

	  If unsure, say N.

#
# For architectures that know their compiler __int128 support is sound
#
config ARCH_SUPPORTS_INT128
	bool

source "Kconfig.debug"
```
